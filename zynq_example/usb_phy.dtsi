/ {
      usb_phy0:usb_phy@0 { 
      compatible = "ulpi-phy";
      #phy-cells = <0>;
      reg = <0xe0002000 0x1000>;
      view-port = <0x170>;
      drv-vbus;
    };
};

&usb0 {
     phy_type = "ulpi";
     usb-phy = <&usb_phy0>;
	usb-reset = <&gpio0 46 0>;
};